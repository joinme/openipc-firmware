## general/package/night-watchdog/Config.in
```kconfig
config BR2_PACKAGE_NIGHT_WATCHDOG
	bool "night-watchdog"
	default n
	help
	  Night watchdog script and init service.
	  Installs /usr/bin/night_watchdog.sh and /etc/init.d/S99night.
```
